## main/Kconfig.projbuild
```kconfig
menu "ESP32 API LED Example Configuration"

    config APP_WIFI_SSID
        string "Wi-Fi SSID"
        default "YOUR_WIFI_SSID"
        help
            Wi-Fi network SSID.

    config APP_WIFI_PASSWORD
        string "Wi-Fi password"
        default "YOUR_WIFI_PASSWORD"
        help
            Wi-Fi network password.

    config APP_WIFI_MAX_RETRIES
        int "Wi-Fi maximum retries"
        range 1 100
        default 10
        help
            Maximum number of Wi-Fi reconnection attempts.

    config APP_WIFI_RETRY_DELAY_MS
        int "Wi-Fi retry delay (ms)"
        range 100 60000
        default 2000
        help
            Delay between Wi-Fi reconnection attempts.

    config APP_API_URL
        string "Endpoint API URL"
        default "https://example.com/endpoint"
        help
            HTTPS endpoint returning JSON containing the configured
            JSON field.

    config APP_API_JSON_FIELD
        string "JSON value field"
        default "value"
        help
            JSON field containing the integer value.

    config APP_HTTP_TIMEOUT_MS
        int "HTTP timeout (ms)"
        range 1000 120000
        default 10000
        help
            HTTPS request timeout.

    config APP_RESPONSE_BUFFER_SIZE
        int "HTTP response buffer size"
        range 128 65536
        default 1024
        help
            Maximum size of the HTTP response JSON document.

    config APP_SNTP_SERVER
        string "SNTP server"
        default "pool.ntp.org"
        help
            NTP server used for system time synchronization.

    config APP_SNTP_MAX_RETRIES
        int "SNTP maximum retries"
        range 1 100
        default 10
        help
            Maximum number of attempts to synchronize system time.

    config APP_SNTP_RETRY_DELAY_MS
        int "SNTP retry delay (ms)"
        range 100 60000
        default 2000
        help
            Delay between SNTP synchronization attempts.

    config APP_TIMEZONE
        string "Time zone"
        default "UTC0"
        help
            POSIX TZ string used for local time conversion.

    config APP_LED_GPIO_PIN
        int "LED GPIO pin"
        range 0 38
        default 2
        help
            GPIO number connected to the status LED.

    config APP_LED_ACTIVE_LOW
        bool "LED is active-low"
        default n
        help
            Enable if the LED turns ON when GPIO is driven LOW.

    config APP_LED_THRESHOLD
        int "LED threshold value"
        range -2147483648 2147483647
        default 3
        help
            Integer threshold for the LED decision.
            If the API value is strictly less than this threshold,
            the LED is switched OFF. Otherwise it is switched ON.

    config APP_LOOP_INTERVAL_MS
        int "Loop interval (ms)"
        range 1000 3600000
        default 10000
        help
            Delay between successive API requests.

endmenu
```

## sdkconfig.defaults
```kconfig
#
# ESP32 API LED Example
# ESP-IDF 6.0.2 / ESP32
#

#
# Certificate Bundle Configuration
#
# Use ESP-IDF's built-in CA bundle for HTTPS certificate verification.
# This is suitable for public CAs such as Let's Encrypt.
#
CONFIG_MBEDTLS_CERTIFICATE_BUNDLE=y
CONFIG_MBEDTLS_DEFAULT_CERTIFICATE_BUNDLE=y
CONFIG_MBEDTLS_CERTIFICATE_BUNDLE_DEFAULT_FULL=y

#
# TLS protocols
#
CONFIG_MBEDTLS_SSL_PROTO_TLS1_2=n
CONFIG_MBEDTLS_SSL_PROTO_TLS1_3=y
CONFIG_MBEDTLS_SSL_SERVER_NAME_INDICATION=y

#
# Logging
#
CONFIG_LOG_DEFAULT_LEVEL_INFO=y
CONFIG_LOG_MAXIMUM_LEVEL_INFO=y
CONFIG_LOG_COLORS=y

#
# LWIP / Network Configuration
#
CONFIG_LWIP_MAX_SOCKETS=10
CONFIG_LWIP_TCPIP_TASK_STACK_SIZE=3072
CONFIG_LWIP_SNTP_MAX_SERVERS=1

#
# Task / Memory Allocation
#
CONFIG_ESP_MAIN_TASK_STACK_SIZE=8192
CONFIG_ESP_SYSTEM_EVENT_TASK_STACK_SIZE=2304

#
# Task Watchdog
#
CONFIG_ESP_TASK_WDT_EN=y
CONFIG_ESP_TASK_WDT_INIT=y
CONFIG_ESP_TASK_WDT_TIMEOUT_S=5

#
# Flash Configuration
#
CONFIG_ESPTOOLPY_FLASHMODE_DIO=y
CONFIG_ESPTOOLPY_FLASHFREQ_40M=y
CONFIG_ESPTOOLPY_FLASHSIZE_4MB=y

#
# Partition Configuration
#
CONFIG_PARTITION_TABLE_CUSTOM=y
CONFIG_PARTITION_TABLE_CUSTOM_FILENAME="partitions.csv"
CONFIG_PARTITION_TABLE_OFFSET=0x8000
```
